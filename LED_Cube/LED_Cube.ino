/*
 * 4x4x4 LED Cube 
 * 
 * @university Poznań University of Technology
 * @faculty    Automatic Control and Robotics
 * @year       2015/2016
 * @author     Rafał Guźniczak <rafal.guzniczak@student.put.poznan.pl>
 */

// This library provides interfaces for a program to access data stored in program space (flash memory) of the device
#include <avr/pgmspace.h>
// This library allows you to communicate with I2C / TWI devices
#include <Wire.h>
// I2C PCF8574 library for Arduino
#include <PCF8574.h>

PCF8574 expander;

#define CUBESIZE 4
#define PLANESIZE CUBESIZE*CUBESIZE
#define PLANETIME 3333 // time each plane is displayed in us -> 100 Hz refresh
#define TIMECONST 10 // multiplies DisplayTime to get ms?
#define BUTTON_PIN 3 // Button connected to pin on expander
#define MODE_MAX 2 // Number of available patterns

const char PatternTable1[] PROGMEM = {

  B0001,B0000,B0000,B0000,B0001,B0000,B0000,B0000,B0000,B0000,B0000,B0000,B0000,B0000,B0000,B0000,10,
  B0011,B0000,B0000,B0000,B0011,B0000,B0000,B0000,B0000,B0000,B0000,B0000,B0000,B0000,B0000,B0000,10,
  B0011,B0010,B0000,B0000,B0011,B0010,B0000,B0000,B0000,B0000,B0000,B0000,B0000,B0000,B0000,B0000,10,
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  B0000, B0000, B0000, B0000, B0000, B0000, B0000, B0000, B0000, B0000, B0000, B0000, B0000, B0000, B0000, B0000, 0
};

const char PatternTable2[] PROGMEM = {

  B0000,B0000,B0000,B0000, B0000,B0000,B0000,B0000, B0000,B0000,B0000,B0000, B0000,B0000,B0000,B0000, 100,

  B0000,B0000,B0100,B0000, B0000,B0000,B0000,B0000, B0000,B0000,B0000,B0000, B0000,B0000,B0000,B0000, 20,
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  B0000,B0000,B0000,B0000, B0000,B0000,B0000,B0000, B0000,B0000,B0000,B0000, B0000,B0000,B0000,B0000, 10,

  // Last element
  B0000, B0000, B0000, B0000, B0000, B0000, B0000, B0000, B0000, B0000, B0000, B0000, B0000, B0000, B0000, B0000, 0
};

const char StartTable[] PROGMEM = {
  
  B1111,B1111,B1111,B1111, B1111,B1111,B1111,B1111, B1111,B1111,B1111,B1111, B1111,B1111,B1111,B1111, 40,
  B0111,B0111,B0111,B0111, B1111,B1111,B1111,B1111, B1111,B1111,B1111,B1111, B1111,B1111,B1111,B1111, 10,
  B0111,B0111,B0111,B0111, B0111,B0111,B0111,B0111, B1111,B1111,B1111,B1111, B1111,B1111,B1111,B1111, 10,
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  B0000,B0000,B0000,B0000, B0000,B0000,B0000,B0000, B0000,B0000,B0000,B0000, B0000,B0000,B0000,B0000, 40,
  
  // Last element
  B0000, B0000, B0000, B0000, B0000, B0000, B0000, B0000, B0000, B0000, B0000, B0000, B0000, B0000, B0000, B0000, 0
};

int LEDPin[] = {16, 17, 2, 3, 4, 5, 6, 7, 8, 9, 10, 11, 12, 13, 14, 15}; // 16 common anodes
int PlanePin[] = {4, 5, 6, 7}; // 4 common cathodes connected to expander

int mode  = 0;
int start = 0;

// Initialization
void setup()
{
  // Initiate the Wire library and join the I2C bus as slave.
  Wire.begin();
  // Opens serial port, sets data rate to 9600 bps
  Serial.begin(9600);

  int pin; // Loop counter
  // Set up LED pins as outputs (active HIGH)
  for (pin = 0; pin < PLANESIZE; pin++) {
    pinMode( LEDPin[pin], OUTPUT );
  }

  // Starts communication with expander on address 0x38
  expander.begin(0x38);
  
  // Set up plane pins as outputs (active LOW)
  for (pin = 0; pin < CUBESIZE; pin++) {
    expander.pinMode( PlanePin[pin], OUTPUT );
  }

  // Set button pin as input
  expander.pinMode(BUTTON_PIN, INPUT_PULLUP);
}

void loop()
{
  //boolean button_pressed = handle_button();
  //Serial.print(button_pressed ? "^" : ".");
  if ( start == 0) {
    show( StartTable );
    start = 1;
  }
  
  switch (mode) {
    case 0:
      show( PatternTable1 );
      break;
    case 1:
      show( PatternTable2 );
      break;
    default: 
      show( PatternTable1 );
    break;
  }
  Serial.println(mode);
}

// 
/******************************************************************************
* show() - Display pattern in table until DisplayTime is zero (then repeat)   *
*                                                                             *
* @param      const char PatternTable                                         *
* @return     void                                                            *
*******************************************************************************/
void show( const char* PatternTable )
{
  // Declare variables
  byte PatternBuf[PLANESIZE]; // Saves current pattern from PatternTable
  int PatternIdx;
  byte DisplayTime; // time*100ms to display pattern
  unsigned long EndTime;
  int plane; // Loop counter for cube refresh
  int patbufidx; // Indexes which byte from pattern buffer
  int ledrow; // Counts LEDs in refresh loop
  int ledcol; // Counts LEDs in refresh loop
  int ledpin; // Counts LEDs in refresh loop
  // Initialize PatternIdx to beginning of pattern table
  PatternIdx = 0;
  // Loop over entries in pattern table - while DisplayTime>0
  do {
    // Read pattern from PROGMEM and save in array
    memcpy_P( PatternBuf, PatternTable + PatternIdx, PLANESIZE );
    PatternIdx += PLANESIZE;
    // Read DisplayTime from PROGMEM and increment index
    DisplayTime = pgm_read_byte_near( PatternTable + PatternIdx++ );
    // Compute EndTime from current time (ms) and DisplayTime
    EndTime = millis() + ((unsigned long) DisplayTime) * TIMECONST;

    // Loop while DisplayTime>0 and current time < EndTime
    while ( millis() < EndTime ) {
      patbufidx = 0; // Reset index counter to beginning of buffer
      // Loop over planes
      for (plane = 0; plane < CUBESIZE; plane++) {
        // Turn previous plane off
        if (plane == 0) {
          expander.digitalWrite( PlanePin[CUBESIZE - 1], LOW );
        } else {
          expander.digitalWrite( PlanePin[plane - 1], LOW );
        }

        // Load current plane pattern data into ports
        ledpin = 0;
        for (ledrow = 0; ledrow < CUBESIZE; ledrow++) {
          for (ledcol = 0; ledcol < CUBESIZE; ledcol++) {
            digitalWrite( LEDPin[ledpin++], PatternBuf[patbufidx] & (1 << ledcol) );
          }
          patbufidx++;
        }

        // Turn current plane on
        expander.digitalWrite( PlanePin[plane], HIGH );
        // delay PLANETIME us
        delayMicroseconds( PLANETIME );
      } // for plane
    } // while <EndTime
    
    if (expander.digitalRead(3) == LOW) {
      show( StartTable );

      if (mode == MODE_MAX-1) {
        mode = 0;
      } else {
        mode++;
      }
    break;
    }
    
  } while (DisplayTime > 0); // read patterns until time=0 which signals end
}

